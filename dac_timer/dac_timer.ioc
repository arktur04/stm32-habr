# file: dac_timer.ioc
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DAC.DAC_Channel=DAC_CHANNEL_1
DAC.DAC_OutputBuffer=DAC_OUTPUTBUFFER_ENABLE
DAC.WaveGeneration=DISABLE
Mcu.Family=STM32F7
Mcu.Name=STM32F767Z(G-I)Tx
Mcu.Package=LQFP144
NVIC.PriorityGroup=NVIC_PRIORITYGROUP_4
NVIC.TIM1_UP_TIM10_IRQn=true\:0\:0\:false\:false\:true
PA4.Signal=COMP_DAC1_group
ProjectManager.HeapSize=0x200
ProjectManager.StackSize=0x400
ProjectManager.TargetToolchain=TrueSTUDIO
RCC.AHBCLKDivider=RCC_SYSCLK_DIV1
RCC.AHBFreq_Value=216000000
RCC.APB1CLKDivider=RCC_HCLK_DIV4
RCC.APB1Freq_Value=54000000
RCC.APB1TimFreq_Value=108000000
RCC.APB2CLKDivider=RCC_HCLK_DIV2
RCC.APB2Freq_Value=108000000
RCC.APB2TimFreq_Value=216000000
RCC.CECEnable=false
RCC.ClockTypeHCLK=RCC_CLOCKTYPE_HCLK
RCC.ClockTypePCLK1=RCC_CLOCKTYPE_PCLK1
RCC.ClockTypePCLK2=RCC_CLOCKTYPE_PCLK2
RCC.ClockTypeSysClk=RCC_CLOCKTYPE_SYSCLK
RCC.CortexFreq_Value=216000000
RCC.Cortex_Div=SYSTICK_CLKSOURCE_HCLK
RCC.EnableHSE=false
RCC.EnableHSERTCDevisor=false
RCC.EnableLSE=false
RCC.EnableLSERTC=false
RCC.EnbaleCSS=false
RCC.ExtClockEnable=false
RCC.HCLKFreq_Value=216000000
RCC.HSEState=RCC_HSE_OFF
RCC.HSE_VALUE=25000000
RCC.HSIState=RCC_HSI_ON
RCC.HSI_VALUE=16000000
RCC.I2C1Enable=false
RCC.I2C2Enable=false
RCC.I2C3Enable=false
RCC.I2C4Enable=false
RCC.I2SEnable=false
RCC.LCDEnable=false
RCC.LPTIM1Enable=false
RCC.LSE_VALUE=32768
RCC.LSIState=RCC_LSI_OFF
RCC.MCO1OutPutEnable=false
RCC.MCO2I2SEnable=false
RCC.MCO2OutPutEnable=false
RCC.OscillatorTypeHSI=RCC_OSCILLATORTYPE_HSI
RCC.PLLI2SP=RCC_PLLP_DIV2
RCC.PLLM=8
RCC.PLLN=216
RCC.PLLP=RCC_PLLP_DIV2
RCC.PLLSAIP=RCC_PLLSAIP_DIV2
RCC.PLLSAIRDiv=RCC_PLLSAIDIVR_2
RCC.PLLState=RCC_PLL_ON
RCC.RCC_MCODiv1=RCC_MCODIV_1
RCC.RCC_MCODiv2=RCC_MCODIV_1
RCC.RCC_RTC_Clock_Source_FROM_HSE=RCC_RTCCLKSOURCE_HSE_DIV2
RCC.RTCEnable=false
RCC.SAI1Enable=false
RCC.SAI2Enable=false
RCC.SDMMC1Enable=false
RCC.SPDIFEnable=false
RCC.SYSCLKFreq_VALUE=216000000
RCC.SYSCLKSource=RCC_SYSCLKSOURCE_PLLCLK
RCC.UART4Enable=false
RCC.UART5Enable=false
RCC.UART7Enable=false
RCC.UART8Enable=false
RCC.USART1Enable=false
RCC.USART2Enable=false
RCC.USART3Enable=false
RCC.USART6Enable=false
RCC.USBEnable=false
RCC.USBFreq_Value=216000000
RCC.VCOOutputFreq_Value=432000000
SH.COMP_DAC1_group.0=DAC_OUT1,DAC_OUT1
TIM1.Period=1
TIM1.Prescaler=215
VP_TIM1_VS_ClockSourceINT.Mode=Internal
board=dac_timer

// file: Src/main.c
/**
  ******************************************************************************
  * File Name          : main.c
  * Description        : Main program body
  ******************************************************************************
  *
  * COPYRIGHT(c) 2017 STMicroelectronics
  *
  * Redistribution and use in source and binary forms, with or without modification,
  * are permitted provided that the following conditions are met:
  *   1. Redistributions of source code must retain the above copyright notice,
  *      this list of conditions and the following disclaimer.
  *   2. Redistributions in binary form must reproduce the above copyright notice,
  *      this list of conditions and the following disclaimer in the documentation
  *      and/or other materials provided with the distribution.
  *   3. Neither the name of STMicroelectronics nor the names of its contributors
  *      may be used to endorse or promote products derived from this software
  *      without specific prior written permission.
  *
  * THIS SOFTWARE IS PROVIDED BY THE COPYRIGHT HOLDERS AND CONTRIBUTORS "AS IS"
  * AND ANY EXPRESS OR IMPLIED WARRANTIES, INCLUDING, BUT NOT LIMITED TO, THE
  * IMPLIED WARRANTIES OF MERCHANTABILITY AND FITNESS FOR A PARTICULAR PURPOSE ARE
  * DISCLAIMED. IN NO EVENT SHALL THE COPYRIGHT HOLDER OR CONTRIBUTORS BE LIABLE
  * FOR ANY DIRECT, INDIRECT, INCIDENTAL, SPECIAL, EXEMPLARY, OR CONSEQUENTIAL
  * DAMAGES (INCLUDING, BUT NOT LIMITED TO, PROCUREMENT OF SUBSTITUTE GOODS OR
  * SERVICES; LOSS OF USE, DATA, OR PROFITS; OR BUSINESS INTERRUPTION) HOWEVER
  * CAUSED AND ON ANY THEORY OF LIABILITY, WHETHER IN CONTRACT, STRICT LIABILITY,
  * OR TORT (INCLUDING NEGLIGENCE OR OTHERWISE) ARISING IN ANY WAY OUT OF THE USE
  * OF THIS SOFTWARE, EVEN IF ADVISED OF THE POSSIBILITY OF SUCH DAMAGE.
  *
  ******************************************************************************
  */
#include "main.h"
#include "stm32f7xx_hal.h"

/* USER CODE BEGIN Includes */
#include "math.h"
/* USER CODE END Includes */

DAC_HandleTypeDef hdac;

TIM_HandleTypeDef htim1;

/* USER CODE BEGIN PV */
/* Private variables ---------------------------------------------------------*/

/* USER CODE END PV */

void SystemClock_Config(void);
void Error_Handler(void);
static void MX_GPIO_Init(void);
static void MX_DAC_Init(void);
static void MX_TIM1_Init(void);

/* USER CODE BEGIN PFP */
/* Private function prototypes -----------------------------------------------*/

/* USER CODE END PFP */

/* USER CODE BEGIN 0 */
//the phase is represented as a fixed point value
//where low 16 bits are considered as a fractional part, and high 16 bits as a integer part

// macro for conversion a fixed point value to an integer value. The value 0x8000 is added for rounding
#define FIXED_TO_INT(x) ((x) >> 16)
#define INT_TO_FIXED(x) ((x) << 16)

volatile uint32_t * dac;
//#define N 3216
#define N 2500
#define DAC_SHIFT 2047
static uint16_t cosine[N + 1];
//const uint32_t delta = 0x3333; // 0.2 -10 Hz
//const uint32_t delta = 0x20000; // 2 -100 Hz
//const uint32_t delta = 0x140000; // 20 -1 kHz
//const uint32_t delta = 0xc80000; // 200 -10 kHz
const uint32_t delta = 0x7d00000; // 2000 -100 kHz

void HAL_TIM_PeriodElapsedCallback(TIM_HandleTypeDef *htim)
{
  static int val = 0;
  static uint32_t phase = 0;
  *(uint32_t*)(DAC_BASE + 0x00000008U) = val;
  phase += delta;
  phase = phase > INT_TO_FIXED(N * 4) - 1 ? phase - INT_TO_FIXED(N * 4): phase;
  uint32_t intphase = FIXED_TO_INT(phase);
  if(intphase < N) {
    val = DAC_SHIFT + cosine[intphase];
  }
  else if(intphase < (2 * N)) {
    val = DAC_SHIFT - cosine[2 * N - intphase];
  }
  else if(intphase < (3 * N)) {
    val = DAC_SHIFT - cosine[intphase - 2 * N];
  }
  else {
    val = DAC_SHIFT + cosine[4 * N - intphase];
  }
}
/* USER CODE END 0 */

int main(void)
{

  /* MCU Configuration----------------------------------------------------------*/

  /* Reset of all peripherals, Initializes the Flash interface and the Systick. */
  HAL_Init();

  /* Configure the system clock */
  SystemClock_Config();

  /* Initialize all configured peripherals */
  MX_GPIO_Init();
  MX_DAC_Init();
  MX_TIM1_Init();

  /* USER CODE BEGIN 2 */
  const float A = 2047;
  const float PI = 3.1415927;
  for(int i = 0; i < N + 1; i++) {
    cosine[i] = (uint16_t)(round(A * cos((i * PI) / ((N + 1) * 2.0))));
  }
  HAL_TIM_Base_Start_IT(&htim1);
  __HAL_DAC_ENABLE(&hdac, DAC_CHANNEL_1);
  /* USER CODE END 2 */

  /* Infinite loop */
  while (1)
  {

  }

}

/** System Clock Configuration
*/
void SystemClock_Config(void)
{

  RCC_OscInitTypeDef RCC_OscInitStruct;
  RCC_ClkInitTypeDef RCC_ClkInitStruct;

    /**Configure the main internal regulator output voltage
    */
  __HAL_RCC_PWR_CLK_ENABLE();

  __HAL_PWR_VOLTAGESCALING_CONFIG(PWR_REGULATOR_VOLTAGE_SCALE1);

    /**Initializes the CPU, AHB and APB busses clocks
    */
  RCC_OscInitStruct.OscillatorType = RCC_OSCILLATORTYPE_HSI;
  RCC_OscInitStruct.HSIState = RCC_HSI_ON;
  RCC_OscInitStruct.HSICalibrationValue = 16;
  RCC_OscInitStruct.PLL.PLLState = RCC_PLL_ON;
  RCC_OscInitStruct.PLL.PLLSource = RCC_PLLSOURCE_HSI;
  RCC_OscInitStruct.PLL.PLLM = 8;
  RCC_OscInitStruct.PLL.PLLN = 216;
  RCC_OscInitStruct.PLL.PLLP = RCC_PLLP_DIV2;
  RCC_OscInitStruct.PLL.PLLQ = 2;
  if (HAL_RCC_OscConfig(&RCC_OscInitStruct) != HAL_OK)
  {
    Error_Handler();
  }

    /**Activate the Over-Drive mode
    */
  if (HAL_PWREx_EnableOverDrive() != HAL_OK)
  {
    Error_Handler();
  }

    /**Initializes the CPU, AHB and APB busses clocks
    */
  RCC_ClkInitStruct.ClockType = RCC_CLOCKTYPE_HCLK|RCC_CLOCKTYPE_SYSCLK
                              |RCC_CLOCKTYPE_PCLK1|RCC_CLOCKTYPE_PCLK2;
  RCC_ClkInitStruct.SYSCLKSource = RCC_SYSCLKSOURCE_PLLCLK;
  RCC_ClkInitStruct.AHBCLKDivider = RCC_SYSCLK_DIV1;
  RCC_ClkInitStruct.APB1CLKDivider = RCC_HCLK_DIV4;
  RCC_ClkInitStruct.APB2CLKDivider = RCC_HCLK_DIV2;

  if (HAL_RCC_ClockConfig(&RCC_ClkInitStruct, FLASH_LATENCY_7) != HAL_OK)
  {
    Error_Handler();
  }

    /**Configure the Systick interrupt time
    */
  HAL_SYSTICK_Config(HAL_RCC_GetHCLKFreq()/1000);

    /**Configure the Systick
    */
  HAL_SYSTICK_CLKSourceConfig(SYSTICK_CLKSOURCE_HCLK);

  /* SysTick_IRQn interrupt configuration */
  HAL_NVIC_SetPriority(SysTick_IRQn, 1, 0);
}

/* DAC init function */
static void MX_DAC_Init(void)
{

  DAC_ChannelConfTypeDef sConfig;

    /**DAC Initialization
    */
  hdac.Instance = DAC;
  if (HAL_DAC_Init(&hdac) != HAL_OK)
  {
    Error_Handler();
  }

    /**DAC channel OUT1 config
    */
  sConfig.DAC_Trigger = DAC_TRIGGER_NONE;
  sConfig.DAC_OutputBuffer = DAC_OUTPUTBUFFER_ENABLE;
  if (HAL_DAC_ConfigChannel(&hdac, &sConfig, DAC_CHANNEL_1) != HAL_OK)
  {
    Error_Handler();
  }

}

/* TIM1 init function */
static void MX_TIM1_Init(void)
{

  TIM_ClockConfigTypeDef sClockSourceConfig;
  TIM_MasterConfigTypeDef sMasterConfig;

  htim1.Instance = TIM1;
  htim1.Init.Prescaler = 215;
  htim1.Init.CounterMode = TIM_COUNTERMODE_UP;
  htim1.Init.Period = 1;
  htim1.Init.ClockDivision = TIM_CLOCKDIVISION_DIV1;
  htim1.Init.RepetitionCounter = 0;
  htim1.Init.AutoReloadPreload = TIM_AUTORELOAD_PRELOAD_DISABLE;
  if (HAL_TIM_Base_Init(&htim1) != HAL_OK)
  {
    Error_Handler();
  }

  sClockSourceConfig.ClockSource = TIM_CLOCKSOURCE_INTERNAL;
  if (HAL_TIM_ConfigClockSource(&htim1, &sClockSourceConfig) != HAL_OK)
  {
    Error_Handler();
  }

  sMasterConfig.MasterOutputTrigger = TIM_TRGO_RESET;
  sMasterConfig.MasterOutputTrigger2 = TIM_TRGO2_RESET;
  sMasterConfig.MasterSlaveMode = TIM_MASTERSLAVEMODE_DISABLE;
  if (HAL_TIMEx_MasterConfigSynchronization(&htim1, &sMasterConfig) != HAL_OK)
  {
    Error_Handler();
  }

}

/** Pinout Configuration
*/
static void MX_GPIO_Init(void)
{

  /* GPIO Ports Clock Enable */
  __HAL_RCC_GPIOA_CLK_ENABLE();

}

void Error_Handler(void)
{
  while(1)
  {
  }
}

/************************ (C) COPYRIGHT STMicroelectronics *****END OF FILE****/
